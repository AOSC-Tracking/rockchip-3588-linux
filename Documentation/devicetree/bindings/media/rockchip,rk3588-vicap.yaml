## Documentation/devicetree/bindings/media/rockchip,rk3588-vicap.yaml
```yaml
# SPDX-License-Identifier: (GPL-2.0 OR BSD-2-Clause)
%YAML 1.2
---
$id: http://devicetree.org/schemas/media/rockchip,rk3588-vicap.yaml#
$schema: http://devicetree.org/meta-schemas/core.yaml#

title: Rockchip RK3588 Video Capture (VICAP)

maintainers:
  - Michael Riesch <michael.riesch@collabora.com>

description:
  The Rockchip RK3588 Video Capture (VICAP) block features a digital video
  port (DVP, a parallel video interface) and six MIPI CSI-2 ports. It receives
  the data from camera sensors, video decoders, or other companion ICs and
  transfers it into system main memory by AXI bus and/or passes it the image
  signal processing (ISP) blocks.

properties:
  compatible:
    enum:
      - const: rockchip,rk3588-vicap

  reg:
    maxItems: 1

  interrupts:
    maxItems: 1

  clocks:
    items:
      - description: ACLK
      - description: HCLK
      - description: DCLK
      - description: ICLK0
      - description: ICLK1

  clock-names:
    items:
      - const: aclk
      - const: hclk
      - const: dclk
      - const: iclk_host0
      - const: iclk_host1

  iommus:
    maxItems: 2

  resets:
    maxItems: 9

  rockchip,grf:
    $ref: /schemas/types.yaml#/definitions/phandle
    description: Phandle to general register file used for video input block control.

  power-domains:
    maxItems: 1

  ports:
    $ref: /schemas/graph.yaml#/properties/ports

    properties:
      port@0:
        $ref: /schemas/graph.yaml#/$defs/port-base
        unevaluatedProperties: false
        description: The digital video port (DVP, a parallel video interface).

        properties:
          endpoint:
            $ref: video-interfaces.yaml#
            unevaluatedProperties: false

            properties:
              bus-type:
                enum: [5, 6]

            required:
              - bus-type

      port@1:
        $ref: /schemas/graph.yaml#/properties/port
        description: Port connected to the MIPI CSI-2 receiver 0 output.

        properties:
          endpoint:
            $ref: video-interfaces.yaml#
            unevaluatedProperties: false

      port@2:
        $ref: /schemas/graph.yaml#/properties/port
        description: Port connected to the MIPI CSI-2 receiver 1 output.

        properties:
          endpoint:
            $ref: video-interfaces.yaml#
            unevaluatedProperties: false

      port@3:
        $ref: /schemas/graph.yaml#/properties/port
        description: Port connected to the MIPI CSI-2 receiver 2 output.

        properties:
          endpoint:
            $ref: video-interfaces.yaml#
            unevaluatedProperties: false

      port@4:
        $ref: /schemas/graph.yaml#/properties/port
        description: Port connected to the MIPI CSI-2 receiver 3 output.

        properties:
          endpoint:
            $ref: video-interfaces.yaml#
            unevaluatedProperties: false

      port@5:
        $ref: /schemas/graph.yaml#/properties/port
        description: Port connected to the MIPI CSI-2 receiver 4 output.

        properties:
          endpoint:
            $ref: video-interfaces.yaml#
            unevaluatedProperties: false

      port@6:
        $ref: /schemas/graph.yaml#/properties/port
        description: Port connected to the MIPI CSI-2 receiver 5 output.

        properties:
          endpoint:
            $ref: video-interfaces.yaml#
            unevaluatedProperties: false

required:
  - compatible
  - reg
  - interrupts
  - clocks
  - ports

additionalProperties: false

examples:
  - |
    #include <dt-bindings/clock/rockchip,rk3588-cru.h>
    #include <dt-bindings/interrupt-controller/arm-gic.h>
    #include <dt-bindings/interrupt-controller/irq.h>
    #include <dt-bindings/media/video-interfaces.h>
    #include <dt-bindings/power/rk3588-power.h>
    #include <dt-bindings/reset/rockchip,rk3588-cru.h>

    soc {
        #address-cells = <2>;
        #size-cells = <2>;

        TODO
    };
```
