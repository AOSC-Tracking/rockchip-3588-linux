## drivers/pmdomain/rockchip/Kconfig
```kconfig
# SPDX-License-Identifier: GPL-2.0-only
if ARCH_ROCKCHIP || COMPILE_TEST

config ROCKCHIP_PM_DOMAINS
	tristate "Rockchip generic power domain"
	depends on PM
	select PM_GENERIC_DOMAINS
	select PM_GENERIC_DOMAINS_OF
	help
	  Say y here to enable power domain support.
	  In order to meet high performance and low power requirements, a power
	  management unit is designed or saving power when SoC is in low power
	  mode. The PMU is dedicated for managing the power of the whole chip.

	  If unsure, say N.

endif
```

## drivers/power/sequencing/Kconfig
```kconfig
# SPDX-License-Identifier: GPL-2.0-only

menuconfig POWER_SEQUENCING
	tristate "Power Sequencing support"
	help
	  Say Y here to enable the Power Sequencing subsystem.

	  This subsystem is designed to control power to devices that share
	  complex resources and/or require specific power sequences to be run
	  during power-up.

	  If unsure, say no.

if POWER_SEQUENCING

config POWER_SEQUENCING_AP6275P
	tristate "AMPAK Technology AP6275P PMU driver"
	help
	  Say Y here to enable the power sequencing driver for AP6275P
	  Bluetooth/WLAN chipsets.

endif
```
